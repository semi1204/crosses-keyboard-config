## modules/motion-gate/dts/bindings/input_processors/zmk,input-processor-motion-gate.yaml
```yaml
# SPDX-License-Identifier: MIT

description: |
  Passes pointer movement on to another processor (normally zip_temp_layer) only
  once the ball has really moved: the net X/Y travel inside `window-ms` must reach
  `threshold`. Small back-and-forth jitter from bumping the keyboard never gets
  there. The pointer itself still moves, because every event continues down the
  chain. While the target layer (param1) is already active, everything is passed
  on so the layer keeps its timeout. Both params are handed to the target as-is.
compatible: "zmk,input-processor-motion-gate"

include: ip_two_param.yaml

properties:
  target:
    type: phandle
    required: true
  threshold:
    type: int
    required: true
    description: Net |dx| + |dy| (after earlier processors in the chain) that opens the gate.
  window-ms:
    type: int
    default: 200
    description: |
      Movement has to reach the threshold within this many ms. The gate also
      closes again once no movement has arrived for this long.
```

## modules/roll-guard/Kconfig
```kconfig
config ZMK_BEHAVIOR_ROLL_GUARD
	bool
	default y
	depends on DT_HAS_ZMK_BEHAVIOR_ROLL_GUARD_ENABLED || DT_HAS_ZMK_BEHAVIOR_ROLL_GUARD_HOLD_ENABLED

config ZMK_BEHAVIOR_TYPING_SWITCH
	bool
	default y
	depends on DT_HAS_ZMK_BEHAVIOR_TYPING_SWITCH_ENABLED
```

## modules/roll-guard/dts/bindings/behaviors/zmk,behavior-typing-switch.yaml
```yaml
# SPDX-License-Identifier: MIT

description: |
  Sends a key to one of two hold-taps, chosen when it goes down: binding 0 after a pause,
  binding 1 when a key was pressed less than prior-idle-ms ago (typing). The release goes
  to the same hold-tap. Both hold-taps get this key's two parameters.
compatible: "zmk,behavior-typing-switch"

include: two_param.yaml

properties:
  bindings:
    type: phandles
    required: true
  prior-idle-ms:
    type: int
    default: 250
    description: A key pressed sooner than this before the switch goes down counts as typing.
```
