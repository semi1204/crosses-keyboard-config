## modules/roll-guard/Kconfig
```kconfig
config ZMK_BEHAVIOR_ROLL_GUARD
	bool
	default y
	depends on DT_HAS_ZMK_BEHAVIOR_ROLL_GUARD_ENABLED || DT_HAS_ZMK_BEHAVIOR_ROLL_GUARD_HOLD_ENABLED
```

## modules/roll-guard/dts/bindings/behaviors/zmk,behavior-roll-guard-hold.yaml
```yaml
# SPDX-License-Identifier: MIT

description: |
  Hold side of a hold-tap whose keys bound to zmk,behavior-roll-guard must not fire by accident.
  Binding 0 is the real hold (a modifier); binding 1 is what the same key types when tapped.
compatible: "zmk,behavior-roll-guard-hold"

include: zero_param.yaml

properties:
  bindings:
    type: phandle-array
    required: true
  quick-ms:
    type: int
    default: 200
    description: A guarded key pressed sooner than this after the hold-tap went down waits for a release.
```

## modules/roll-guard/dts/bindings/behaviors/zmk,behavior-roll-guard.yaml
```yaml
# SPDX-License-Identifier: MIT

description: |
  A key press that waits when it is rolled into from the roll-guard hold. Released while the hold
  is still down it is tapped under the hold; if the hold is released first, the hold's tap binding
  and then this key are typed instead.
compatible: "zmk,behavior-roll-guard"

include: one_param.yaml
```

## modules/scroll-keys/Kconfig
```kconfig
config ZMK_INPUT_PROCESSOR_SCROLL_KEYS
	bool
	default y
	depends on DT_HAS_ZMK_INPUT_PROCESSOR_SCROLL_KEYS_ENABLED
```

## modules/scroll-keys/dts/bindings/input_processors/zmk,input-processor-scroll-keys.yaml
```yaml
# SPDX-License-Identifier: MIT

description: |
  Turn one relative axis into key taps: every `threshold` units in the positive
  direction taps binding 0, in the negative direction binding 1.
  All other relative events are swallowed while this processor is active.
compatible: "zmk,input-processor-scroll-keys"

include: ip_zero_param.yaml

properties:
  code:
    type: int
    required: true
  threshold:
    type: int
    required: true
  bindings:
    type: phandle-array
    required: true
  one-shot-idle-ms:
    type: int
    default: 0
    description: |
      When set, tap at most once per gesture: after a tap, swallow further movement
      until no event has arrived for this many ms, which also clears the accumulator.
```
