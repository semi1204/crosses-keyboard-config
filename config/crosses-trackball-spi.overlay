/* Trackball wiring used by the row2col Crosses PCB. */
#include <zephyr/dt-bindings/pinctrl/nrf-pinctrl.h>

&spi1_default {
    group1 {
        psels = <NRF_PSEL(SPIM_SCK, 0, 17)>,
                <NRF_PSEL(SPIM_MOSI, 0, 20)>,
                <NRF_PSEL(SPIM_MISO, 0, 20)>;
    };
};

&spi1_sleep {
    group1 {
        psels = <NRF_PSEL(SPIM_SCK, 0, 17)>,
                <NRF_PSEL(SPIM_MOSI, 0, 20)>,
                <NRF_PSEL(SPIM_MISO, 0, 20)>;
        low-power-enable;
    };
};
