/* Left-half scan and trackball interrupt for the row2col Crosses PCB. */
#include <zephyr/dt-bindings/gpio/gpio.h>

&kscan0 {
    diode-direction = "row2col";
    // E chattered at the default 5 ms; hold releases a little longer.
    debounce-release-ms = <20>;
    row-gpios = <&pro_micro 5 GPIO_ACTIVE_HIGH>,
                <&pro_micro 19 GPIO_ACTIVE_HIGH>,
                <&pro_micro 20 GPIO_ACTIVE_HIGH>,
                <&pro_micro 21 GPIO_ACTIVE_HIGH>,
                <&pro_micro 7 GPIO_ACTIVE_HIGH>;
    col-gpios = <&pro_micro 0 (GPIO_ACTIVE_HIGH | GPIO_PULL_DOWN)>,
                <&pro_micro 18 (GPIO_ACTIVE_HIGH | GPIO_PULL_DOWN)>,
                <&pro_micro 15 (GPIO_ACTIVE_HIGH | GPIO_PULL_DOWN)>,
                <&pro_micro 10 (GPIO_ACTIVE_HIGH | GPIO_PULL_DOWN)>,
                <&pro_micro 16 (GPIO_ACTIVE_HIGH | GPIO_PULL_DOWN)>,
                <&pro_micro 14 (GPIO_ACTIVE_HIGH | GPIO_PULL_DOWN)>;
};

&trackball_peripheral {
    irq-gpios = <&gpio0 6 (GPIO_ACTIVE_LOW | GPIO_PULL_UP)>;
};

// Left is the central: the left ball is read locally, the right ball arrives over the split.
&trackball_peripheral_listener {
    status = "okay";
    device = <&trackball_peripheral>;
};

&trackball_central_listener {
    status = "okay";
    device = <&trackball_peripheral_split>;
};
